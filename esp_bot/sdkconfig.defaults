## esp_bot/sdkconfig.defaults
```kconfig
# ==========================================
# ESP32-S3-WROOM-1 N8R8 高性能配置
# ==========================================

# --- 8MB Flash (QIO 80MHz，稳定高性能) ---
CONFIG_ESPTOOLPY_FLASHSIZE_8MB=y
CONFIG_ESPTOOLPY_FLASHMODE_QIO=y
CONFIG_ESPTOOLPY_FLASHFREQ_80M=y

# --- 8MB Octal PSRAM 80MHz ---
CONFIG_SPIRAM=y
CONFIG_SPIRAM_MODE_OCT=y
CONFIG_SPIRAM_SPEED_80M=y
CONFIG_SPIRAM_SPEED=80
CONFIG_SPIRAM_USE_MALLOC=y
CONFIG_SPIRAM_MALLOC_ALWAYSINTERNAL=16384
CONFIG_SPIRAM_MALLOC_RESERVE_INTERNAL=32768
CONFIG_FREERTOS_TASK_CREATE_ALLOW_EXT_MEM=y

# --- CPU 160MHz（N8R8 MSPI 最佳组合：160/80 = 2 ✅）---
CONFIG_ESP_DEFAULT_CPU_FREQ_MHZ_160=y
CONFIG_ESP_DEFAULT_CPU_FREQ_MHZ=160

# --- 编译器 -O2 性能优化 ---
CONFIG_COMPILER_OPTIMIZATION_PERF=y
CONFIG_COMPILER_OPTIMIZATION_ASSERTIONS_ENABLE=y
CONFIG_COMPILER_OPTIMIZATION_ASSERTION_LEVEL=2

# --- 32KB I-Cache / 32KB D-Cache 8-way ---
CONFIG_ESP32S3_INSTRUCTION_CACHE_32KB=y
CONFIG_ESP32S3_DATA_CACHE_32KB=y
CONFIG_ESP32S3_INSTRUCTION_CACHE_8WAYS=y
CONFIG_ESP32S3_DATA_CACHE_8WAYS=y

# --- I2S 中断放 IRAM（低延迟音频） ---
CONFIG_I2S_ISR_IRAM_SAFE=y
CONFIG_I2S_CTRL_FUNC_IN_IRAM=y

# --- 自定义分区表 ---
CONFIG_PARTITION_TABLE_CUSTOM=y
CONFIG_PARTITION_TABLE_CUSTOM_FILENAME="partitions.csv"
CONFIG_PARTITION_TABLE_FILENAME="partitions.csv"

# --- TinyUSB CDC（原生 USB 音频推流，增大缓冲减少丢帧） ---
CONFIG_TINYUSB_CDC_ENABLED=y
CONFIG_TINYUSB_CDC_COUNT=1
CONFIG_TINYUSB_CDC_RX_BUFSIZE=512
CONFIG_TINYUSB_CDC_TX_BUFSIZE=1024

# --- 日志：Bootloader WARN / App INFO ---
CONFIG_BOOTLOADER_LOG_LEVEL_WARN=y
CONFIG_BOOTLOADER_LOG_LEVEL=2
CONFIG_LOG_DEFAULT_LEVEL_INFO=y
CONFIG_LOG_DEFAULT_LEVEL=3

# --- FreeRTOS 1000Hz tick ---
CONFIG_FREERTOS_HZ=1000

# --- 主任务栈 4096 ---
CONFIG_ESP_MAIN_TASK_STACK_SIZE=4096

# --- 禁用不需要的功能（纯USB设备，注意 Kconfig 依赖链） ---
# WiFi: ESP-IDF 多个子系统默认选中 esp_wifi，强制关闭会导致编译失败。
# 用 "make default" 关闭即可，Kconfig 会自动处理依赖。
# CONFIG_ESP_WIFI_ENABLED=n  # 依赖链太深，保持默认
# CONFIG_BT_ENABLED=n       # 依赖链太深，保持默认
CONFIG_LWIP_ENABLE=y

# --- 唤醒词模型：小隆小隆 ---
CONFIG_SR_WN_WN9_XIAOLONG=y
```
